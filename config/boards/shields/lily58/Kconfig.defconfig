## config/boards/shields/lily58/Kconfig.defconfig
```kconfig
if SHIELD_LILY58

config ZMK_KEYBOARD_NAME
    default "lily58"
    
config ZMK_DISPLAY
    default y

config ZMK_DISPLAY_SSD1306
    bool "Enable SSD1306 Display"
    default y
    select LVGL

endif
```

## config/boards/shields/trial/Kconfig.defconfig
```kconfig
if SHIELD_TRIAL

config ZMK_KEYBOARD_NAME
    default "trial"
    
config ZMK_DISPLAY
    default y

config ZMK_DISPLAY_SSD1306
    bool "Enable SSD1306 Display"
    default y
    select LVGL

endif
```

## config/west.yml
```yaml
manifest:
  defaults:
    revision: v0.2
  remotes:
    - name: zmkfirmware
      url-base: https://github.com/zmkfirmware
    # Additional modules containing boards/shields/custom code can be listed here as well
    # See https://docs.zephyrproject.org/3.2.0/develop/west/manifest.html#projects
    - name: zmkfirmware
      url-base: https://github.com/zmkfirmware
    - name: mctechnology17
      url-base: https://github.com/mctechnology17
  projects:
    - name: zmk
      remote: zmkfirmware
      import: app/west.yml
    - name: zmk
      remote: zmkfirmware
      revision: main
      import: app/west.yml
    - name: zmk-oled-adapter
      remote: mctechnology17
      revision: main
  self:
    path: config
```
