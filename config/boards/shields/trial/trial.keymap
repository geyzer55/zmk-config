/*
 * Copyright (c) 2020 The ZMK Contributors
 *
 * SPDX-License-Identifier: MIT
 */

#include <behaviors.dtsi>
#include <dt-bindings/zmk/keys.h>
#include <dt-bindings/zmk/bt.h>
#include <dt-bindings/zmk/ext_power.h>

/ {
    keymap {
        compatible = "zmk,keymap";

        default_layer: layer0 {
            bindings = <
                &kp N0 
            >;
        };
    };
};
